//=========================================================
// src/EFM8SB10F8G-A-QFN20_main.c: generated by Hardware Configurator
//
// This file will be updated when saving a document.
// leave the sections inside the "$[...]" comment tags alone
// or they will be overwritten!!
//=========================================================

//-----------------------------------------------------------------------------
// Includes
//-----------------------------------------------------------------------------
#include <SI_EFM8SB1_Register_Enums.h>                  // SFR declarations
#include "InitDevice.h"
#include "peripherals.h"
#include <smb_0.h>
#include <stdint.h>
#include "power.h"
#include "SmaRTClock.h"

// $[Generated Includes]
// [Generated Includes]$

#define UHOME_ID 0x09

//#define UHOME_TEMP
#define UHOME_HUM
//#define UHOME_REED
//#define UHOME_PRESS
//#define UHOME_NONE

#ifdef UHOME_TEMP
#define UHOME_TYPE 0xAA
#define UHOME_TXLEN 8
#define UHOME_TX_DELAY 100000
#endif

#ifdef UHOME_HUM
#define UHOME_TYPE 0xAB
#define UHOME_TXLEN 10
#define UHOME_TX_DELAY 140000
#endif

#ifdef UHOME_NONE
#define UHOME_TYPE 0x00
#define UHOME_TXLEN 8
#define UHOME_TX_DELAY 100000
#endif

uint32_t SI_SEG_XDATA delayi;
uint8_t SI_SEG_XDATA dbuf[10];
uint8_t SI_SEG_XDATA state = 0;

SI_SBIT (SI4012_SDN, SFR_P1, 0);
SI_SBIT (SI4012_IRQ, SFR_P0, 7);
SI_SBIT (SDA, SFR_P0, 0);
SI_SBIT (SCL, SFR_P0, 1);

//-----------------------------------------------------------------------------
// SiLabs_Startup() Routine
// ----------------------------------------------------------------------------
// This function is called immediately after reset, before the initialization
// code is run in SILABS_STARTUP.A51 (which runs before main() ). This is a
// useful place to disable the watchdog timer, which is enable by default
// and may trigger before main() in some instances.
//-----------------------------------------------------------------------------
void SiLabs_Startup(void) {

}

//-----------------------------------------------------------------------------
// main() Routine
// ----------------------------------------------------------------------------
int main(void) {
	uint16_t SI_SEG_XDATA
	temp, bat;

	// Debug trap
	while (!SCL)
		;

	// Call hardware initialization routine
	enter_DefaultMode_from_RESET();

	dbuf[0] = 0xAA;
	dbuf[1] = 0xFF;
	dbuf[2] = UHOME_TYPE;
	dbuf[3] = UHOME_ID; // ID
	dbuf[4] = 0x00; // Temp1
	dbuf[5] = 0x00; // Temp2
	dbuf[6] = 0x00; // Bat1
	dbuf[7] = 0x00; // Bat2
	dbuf[8] = 0x00;
	dbuf[9] = 0x00;

	SMB0_reset();
	SMB0_init(SMB0_TIMER1, true);

	// keep this so that the chip can be programmed
	for (delayi = 500000; delayi > 0; delayi--)
		;

	// enable low power stuff
	RTC0CN0_Local = 0xC0;
	RTC0CN0_SetBits(RTC0TR + RTC0AEN + ALRM);
	LPM_Init();
	LPM_Enable_Wakeup (RTC);
	RTC_Alarm = 1;

	// enable RF transceiver
	SI4012_SDN = 0;

	while (1) {
		if (RTC_Failure) {
			RTC_Failure = 0;
			while (1) {
				SCL = !SCL;
			}
		}

		if (RTC_Alarm) {
			RTC_Alarm = 0;
		}

		switch (state) {
		case 0:
			SI4012_SDN = 0;

			si4012_change_state();
			for (delayi = 100000; delayi > 0; delayi--)
				;

			si4012_init();

#ifdef UHOME_TEMP
			si7055_measure();

			temp = si7055_read();
			dbuf[4] = temp & 0xFF;
			dbuf[5] = (temp >> 8) & 0xFF;
#endif
#ifdef UHOME_HUM
			temp = si7006_read_hum();
			dbuf[8] = temp & 0xFF;
			dbuf[9] = (temp >> 8) & 0xFF;

			bat = si7006_read_temp();
			dbuf[4] = bat & 0xFF;
			dbuf[5] = (bat >> 8) & 0xFF;
#endif

			bat = si4012_get_battery();
			dbuf[6] = bat & 0xFF;
			dbuf[7] = (bat >> 8) & 0xFF;
			break;

		case 1:
			si4012_led(1);
			si4012_set_data(dbuf, UHOME_TXLEN);
			si4012_led(0);
			si4012_tx_shutdown();
			break;

		case 2:
			for (delayi = UHOME_TX_DELAY; delayi > 0; delayi--)
				;

			SMB0_stop();

			SMB0CF = SMB0CF_ENSMB__DISABLED;
			SDA = 1;
			SCL = 1;

			SI4012_SDN = 1;

			LPM (SLEEP);
			SMB0CF |= SMB0CF_SMBCS__TIMER1 | SMB0CF_INH__SLAVE_DISABLED
					| SMB0CF_ENSMB__ENABLED;

			SMB0_reset();
			SMB0_init(SMB0_TIMER1, true);
			break;
		}

		state++;
		if (state == 3) {
			state = 0;
		}
	}
}

// $[Generated Run-time code]
// [Generated Run-time code]$

// $[SiLabs Startup]
// [SiLabs Startup]$

